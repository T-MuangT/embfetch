## src/rtos/nuttx/Kconfig
```kconfig
config EXAMPLES_EMBFETCH
    tristate "Embfetch: Neofetch-style system information display command"
    default n
    ---help---
        Prints system information in a neofetch-style summary
        including board info, kernel version, uptime, and
        memory usage.
```

## src/rtos/rt-thread/Kconfig
```kconfig
config PKG_USING_EMBFETCH
    bool "Embfetch: Neofetch-style system information display command"
    default n
    help
      Prints system information in a neofetch-style summary
      including board info, kernel version, uptime, and
      memory usage.
```

## zephyr/Kconfig
```kconfig
config EMBFETCH
    bool "Embfetch: Neofetch-style system information display command"
    depends on SHELL
    help
      Prints system information in a neofetch-style summary
      including board info, kernel version, uptime, and
      memory usage.
```
